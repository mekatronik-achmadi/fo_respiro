/******************************************************************************/
/* This file has been generated by the uGFX-Studio                            */
/*                                                                            */
/* http://ugfx.org                                                            */
/******************************************************************************/

#include "gui.h"
#include "gfx.h"

#include "ch.h"
#include "hal.h"

static THD_WORKING_AREA(waBlink, 128);
static THD_FUNCTION(thdBlink, arg) {

  (void)arg;

  chRegSetThreadName("blinker");
  while (true) {
    palSetPad(GPIOE, 5);
    chThdSleepMilliseconds(500);
    palClearPad(GPIOE, 5);
    chThdSleepMilliseconds(500);
  }
}

float calibrationData[] = {
    -0.06678,		// ax
    -0.00187,		// bx
    259.06353,		// cx
    0.00039,		// ay
    0.09974,		// by
    -31.92561 		// cy
};

bool_t LoadMouseCalibration(unsigned instance, void *data, size_t sz)
{
    (void)instance;

    if (sz != sizeof(calibrationData) || instance != 0) {
        return FALSE;
    }

    memcpy(data, (void*)&calibrationData, sz);

    return TRUE;
}

int main(int argc, char* argv[])
{
	(void)argc;
	(void)argv;

	gfxInit();
	
	palSetPadMode(GPIOE,5,PAL_MODE_OUTPUT_PUSHPULL);
	chThdCreateStatic(waBlink, sizeof(waBlink), NORMALPRIO+1, thdBlink, NULL);

    gdispSetBacklight(100);
    gdispSetContrast(100);
    gdispSetOrientation(GDISP_ROTATE_90);

	geventListenerInit(&glistener);
	gwinAttachListener(&glistener);

	guiCreate();

	while (1) {
		guiEventLoop();
	}

	return 0;
}


