/******************************************************************************/
/* This file has been generated by the uGFX-Studio                            */
/*                                                                            */
/* http://ugfx.org                                                            */
/******************************************************************************/

#include <stdint.h>
#include <stdio.h>
#include <stdlib.h>
#include <string.h>

#include "gfx.h"

#include "ch.h"
#include "hal.h"

#include "math.h"

#define ADC_GRP1_NUM_CHANNELS   1
#define ADC_GRP1_BUF_DEPTH      100

static adcsample_t samples[ADC_GRP1_NUM_CHANNELS * ADC_GRP1_BUF_DEPTH];

adcsample_t adc0;
uint32_t sum_adc0;

adcsample_t y_0,y_1,dy;

void adccb(ADCDriver *adcp, adcsample_t *buffer, size_t n){
  (void) buffer; (void) n;
  int i;
  if (adcp->state == ADC_COMPLETE) {

    sum_adc0=0;

    for(i=0;i<ADC_GRP1_BUF_DEPTH;i++){
        sum_adc0=sum_adc0+samples[0+(i*ADC_GRP1_NUM_CHANNELS)];
    }

    adc0=sum_adc0/ADC_GRP1_BUF_DEPTH;

   }
 }

static const ADCConversionGroup adcgrpcfg = {
    FALSE,
    ADC_GRP1_NUM_CHANNELS,
    adccb,
    NULL,
    /* HW dependent part.*/
    0,
    0,
    ADC_SMPR2_SMP_AN0(ADC_SAMPLE_239P5),
    0,
    ADC_SQR1_NUM_CH(ADC_GRP1_NUM_CHANNELS),
    0,
    ADC_SQR3_SQ1_N(ADC_CHANNEL_IN0)
};

static THD_WORKING_AREA(wa_adcThread, 128);
static THD_FUNCTION(adcThread,arg) {
  (void)arg;

  while (TRUE) {
    chThdSleepMilliseconds(100);
    adcStartConversion(&ADCD1, &adcgrpcfg, samples, ADC_GRP1_BUF_DEPTH);
  }
}

// A set of data points that will be displayed in the graph
static point data[20] = {
    { 10, 0 },
    { 20, 0 },
    { 30, 0 },
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    { 200,0 }
};

// A graph styling
static GGraphStyle GraphStyle1 = {
    { GGRAPH_POINT_DOT, 0, Blue },          // Point
    { GGRAPH_LINE_NONE, 2, Gray },          // Line
    { GGRAPH_LINE_SOLID, 0, White },        // X axis
    { GGRAPH_LINE_SOLID, 0, White },        // Y axis
    { GGRAPH_LINE_DASH, 5, Gray, 50 },      // X grid
    { GGRAPH_LINE_DOT, 7, Yellow, 50 },     // Y grid
    GWIN_GRAPH_STYLE_POSITIVE_AXIS_ARROWS   // Flags
};

// Another graph styling
static const GGraphStyle GraphStyle2 = {
    { GGRAPH_POINT_SQUARE, 5, Red },        // Point
    { GGRAPH_LINE_DOT, 2, Blue },           // Line
    { GGRAPH_LINE_SOLID, 0, White },        // X axis
    { GGRAPH_LINE_SOLID, 0, White },        // Y axis
    { GGRAPH_LINE_DASH, 5, Gray, 50 },      // X grid
    { GGRAPH_LINE_DOT, 7, Yellow, 50 },     // Y grid
    GWIN_GRAPH_STYLE_POSITIVE_AXIS_ARROWS   // Flags
};

static THD_WORKING_AREA(waBlink, 128);
static THD_FUNCTION(thdBlink, arg) {

  (void)arg;

  chRegSetThreadName("blinker");
  while (true) {
    palSetPad(GPIOE, 5);
    chThdSleepMilliseconds(500);
    palClearPad(GPIOE, 5);
    chThdSleepMilliseconds(500);
  }
}

static uint8_t i;
static THD_WORKING_AREA(waGenData, 128);
static THD_FUNCTION(thdGenData, arg) {

    (void)arg;

    chRegSetThreadName("plot data");

    while (true) {
        for(i=19;i>0;i--){
            data[i].y = data[i-1].y;
        }

       
        y_1=adc0;
        data[0].y = y1;
        
        if(y_1>y_0){dy=y_1-y_0;}
        else{dy=y_0-y_1;}
        y_0=y_1;
        
        gfxSleepMilliseconds(500);
    }
}



int main(int argc, char* argv[])
{
	(void)argc;
	(void)argv;

    GHandle gh;

	gfxInit();
    
    palSetPadMode(GPIOA,0,PAL_MODE_INPUT_ANALOG);
    adcStart(&ADCD1, NULL);
    chThdCreateStatic(wa_adcThread, sizeof(wa_adcThread), NORMALPRIO, adcThread, NULL);

	palSetPadMode(GPIOE,5,PAL_MODE_OUTPUT_PUSHPULL);
	chThdCreateStatic(waBlink, sizeof(waBlink), NORMALPRIO, thdBlink, NULL);
    chThdCreateStatic(waGenData, sizeof(waGenData), NORMALPRIO, thdGenData, NULL);


    {
        GWindowInit wi;

        wi.show = TRUE;
        wi.x = wi.y = 0;
        wi.width = gdispGetWidth();
        wi.height = gdispGetHeight();
        gh = gwinGraphCreate(0, &wi);
    }

    while(TRUE) {
        gwinClear(gh);
        gwinGraphSetOrigin(gh, gwinGetWidth(gh)/8, gwinGetHeight(gh)/8);
        gwinGraphSetStyle(gh, &GraphStyle1);
        gwinGraphDrawAxis(gh);

        gwinGraphStartSet(gh);
        gwinGraphSetStyle(gh, &GraphStyle2);
        gwinGraphDrawAxis(gh);

        gwinGraphDrawPoints(gh, data, sizeof(data)/sizeof(data[0]));
        gfxSleepMilliseconds(10);
    }

	return 0;
}
